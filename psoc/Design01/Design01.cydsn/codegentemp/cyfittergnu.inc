.ifndef INCLUDED_CYFITTERGNU_INC
.set INCLUDED_CYFITTERGNU_INC, 1
.include "cydevicegnu_trm.inc"

/* OUT_1 */
.set OUT_1__0__DM__MASK, 0x38000
.set OUT_1__0__DM__SHIFT, 15
.set OUT_1__0__DR, CYREG_PRT1_DR
.set OUT_1__0__HSIOM, CYREG_HSIOM_PORT_SEL1
.set OUT_1__0__HSIOM_MASK, 0x00F00000
.set OUT_1__0__HSIOM_SHIFT, 20
.set OUT_1__0__INTCFG, CYREG_PRT1_INTCFG
.set OUT_1__0__INTSTAT, CYREG_PRT1_INTSTAT
.set OUT_1__0__MASK, 0x20
.set OUT_1__0__PA__CFG0, CYREG_UDB_PA1_CFG0
.set OUT_1__0__PA__CFG1, CYREG_UDB_PA1_CFG1
.set OUT_1__0__PA__CFG10, CYREG_UDB_PA1_CFG10
.set OUT_1__0__PA__CFG11, CYREG_UDB_PA1_CFG11
.set OUT_1__0__PA__CFG12, CYREG_UDB_PA1_CFG12
.set OUT_1__0__PA__CFG13, CYREG_UDB_PA1_CFG13
.set OUT_1__0__PA__CFG14, CYREG_UDB_PA1_CFG14
.set OUT_1__0__PA__CFG2, CYREG_UDB_PA1_CFG2
.set OUT_1__0__PA__CFG3, CYREG_UDB_PA1_CFG3
.set OUT_1__0__PA__CFG4, CYREG_UDB_PA1_CFG4
.set OUT_1__0__PA__CFG5, CYREG_UDB_PA1_CFG5
.set OUT_1__0__PA__CFG6, CYREG_UDB_PA1_CFG6
.set OUT_1__0__PA__CFG7, CYREG_UDB_PA1_CFG7
.set OUT_1__0__PA__CFG8, CYREG_UDB_PA1_CFG8
.set OUT_1__0__PA__CFG9, CYREG_UDB_PA1_CFG9
.set OUT_1__0__PC, CYREG_PRT1_PC
.set OUT_1__0__PC2, CYREG_PRT1_PC2
.set OUT_1__0__PORT, 1
.set OUT_1__0__PS, CYREG_PRT1_PS
.set OUT_1__0__SHIFT, 5
.set OUT_1__DR, CYREG_PRT1_DR
.set OUT_1__INTCFG, CYREG_PRT1_INTCFG
.set OUT_1__INTSTAT, CYREG_PRT1_INTSTAT
.set OUT_1__MASK, 0x20
.set OUT_1__PA__CFG0, CYREG_UDB_PA1_CFG0
.set OUT_1__PA__CFG1, CYREG_UDB_PA1_CFG1
.set OUT_1__PA__CFG10, CYREG_UDB_PA1_CFG10
.set OUT_1__PA__CFG11, CYREG_UDB_PA1_CFG11
.set OUT_1__PA__CFG12, CYREG_UDB_PA1_CFG12
.set OUT_1__PA__CFG13, CYREG_UDB_PA1_CFG13
.set OUT_1__PA__CFG14, CYREG_UDB_PA1_CFG14
.set OUT_1__PA__CFG2, CYREG_UDB_PA1_CFG2
.set OUT_1__PA__CFG3, CYREG_UDB_PA1_CFG3
.set OUT_1__PA__CFG4, CYREG_UDB_PA1_CFG4
.set OUT_1__PA__CFG5, CYREG_UDB_PA1_CFG5
.set OUT_1__PA__CFG6, CYREG_UDB_PA1_CFG6
.set OUT_1__PA__CFG7, CYREG_UDB_PA1_CFG7
.set OUT_1__PA__CFG8, CYREG_UDB_PA1_CFG8
.set OUT_1__PA__CFG9, CYREG_UDB_PA1_CFG9
.set OUT_1__PC, CYREG_PRT1_PC
.set OUT_1__PC2, CYREG_PRT1_PC2
.set OUT_1__PORT, 1
.set OUT_1__PS, CYREG_PRT1_PS
.set OUT_1__SHIFT, 5

/* OUT_2 */
.set OUT_2__0__DM__MASK, 0x7000
.set OUT_2__0__DM__SHIFT, 12
.set OUT_2__0__DR, CYREG_PRT1_DR
.set OUT_2__0__HSIOM, CYREG_HSIOM_PORT_SEL1
.set OUT_2__0__HSIOM_MASK, 0x000F0000
.set OUT_2__0__HSIOM_SHIFT, 16
.set OUT_2__0__INTCFG, CYREG_PRT1_INTCFG
.set OUT_2__0__INTSTAT, CYREG_PRT1_INTSTAT
.set OUT_2__0__MASK, 0x10
.set OUT_2__0__PA__CFG0, CYREG_UDB_PA1_CFG0
.set OUT_2__0__PA__CFG1, CYREG_UDB_PA1_CFG1
.set OUT_2__0__PA__CFG10, CYREG_UDB_PA1_CFG10
.set OUT_2__0__PA__CFG11, CYREG_UDB_PA1_CFG11
.set OUT_2__0__PA__CFG12, CYREG_UDB_PA1_CFG12
.set OUT_2__0__PA__CFG13, CYREG_UDB_PA1_CFG13
.set OUT_2__0__PA__CFG14, CYREG_UDB_PA1_CFG14
.set OUT_2__0__PA__CFG2, CYREG_UDB_PA1_CFG2
.set OUT_2__0__PA__CFG3, CYREG_UDB_PA1_CFG3
.set OUT_2__0__PA__CFG4, CYREG_UDB_PA1_CFG4
.set OUT_2__0__PA__CFG5, CYREG_UDB_PA1_CFG5
.set OUT_2__0__PA__CFG6, CYREG_UDB_PA1_CFG6
.set OUT_2__0__PA__CFG7, CYREG_UDB_PA1_CFG7
.set OUT_2__0__PA__CFG8, CYREG_UDB_PA1_CFG8
.set OUT_2__0__PA__CFG9, CYREG_UDB_PA1_CFG9
.set OUT_2__0__PC, CYREG_PRT1_PC
.set OUT_2__0__PC2, CYREG_PRT1_PC2
.set OUT_2__0__PORT, 1
.set OUT_2__0__PS, CYREG_PRT1_PS
.set OUT_2__0__SHIFT, 4
.set OUT_2__DR, CYREG_PRT1_DR
.set OUT_2__INTCFG, CYREG_PRT1_INTCFG
.set OUT_2__INTSTAT, CYREG_PRT1_INTSTAT
.set OUT_2__MASK, 0x10
.set OUT_2__PA__CFG0, CYREG_UDB_PA1_CFG0
.set OUT_2__PA__CFG1, CYREG_UDB_PA1_CFG1
.set OUT_2__PA__CFG10, CYREG_UDB_PA1_CFG10
.set OUT_2__PA__CFG11, CYREG_UDB_PA1_CFG11
.set OUT_2__PA__CFG12, CYREG_UDB_PA1_CFG12
.set OUT_2__PA__CFG13, CYREG_UDB_PA1_CFG13
.set OUT_2__PA__CFG14, CYREG_UDB_PA1_CFG14
.set OUT_2__PA__CFG2, CYREG_UDB_PA1_CFG2
.set OUT_2__PA__CFG3, CYREG_UDB_PA1_CFG3
.set OUT_2__PA__CFG4, CYREG_UDB_PA1_CFG4
.set OUT_2__PA__CFG5, CYREG_UDB_PA1_CFG5
.set OUT_2__PA__CFG6, CYREG_UDB_PA1_CFG6
.set OUT_2__PA__CFG7, CYREG_UDB_PA1_CFG7
.set OUT_2__PA__CFG8, CYREG_UDB_PA1_CFG8
.set OUT_2__PA__CFG9, CYREG_UDB_PA1_CFG9
.set OUT_2__PC, CYREG_PRT1_PC
.set OUT_2__PC2, CYREG_PRT1_PC2
.set OUT_2__PORT, 1
.set OUT_2__PS, CYREG_PRT1_PS
.set OUT_2__SHIFT, 4

/* OUT_3 */
.set OUT_3__0__DM__MASK, 0xE00
.set OUT_3__0__DM__SHIFT, 9
.set OUT_3__0__DR, CYREG_PRT1_DR
.set OUT_3__0__HSIOM, CYREG_HSIOM_PORT_SEL1
.set OUT_3__0__HSIOM_MASK, 0x0000F000
.set OUT_3__0__HSIOM_SHIFT, 12
.set OUT_3__0__INTCFG, CYREG_PRT1_INTCFG
.set OUT_3__0__INTSTAT, CYREG_PRT1_INTSTAT
.set OUT_3__0__MASK, 0x08
.set OUT_3__0__PA__CFG0, CYREG_UDB_PA1_CFG0
.set OUT_3__0__PA__CFG1, CYREG_UDB_PA1_CFG1
.set OUT_3__0__PA__CFG10, CYREG_UDB_PA1_CFG10
.set OUT_3__0__PA__CFG11, CYREG_UDB_PA1_CFG11
.set OUT_3__0__PA__CFG12, CYREG_UDB_PA1_CFG12
.set OUT_3__0__PA__CFG13, CYREG_UDB_PA1_CFG13
.set OUT_3__0__PA__CFG14, CYREG_UDB_PA1_CFG14
.set OUT_3__0__PA__CFG2, CYREG_UDB_PA1_CFG2
.set OUT_3__0__PA__CFG3, CYREG_UDB_PA1_CFG3
.set OUT_3__0__PA__CFG4, CYREG_UDB_PA1_CFG4
.set OUT_3__0__PA__CFG5, CYREG_UDB_PA1_CFG5
.set OUT_3__0__PA__CFG6, CYREG_UDB_PA1_CFG6
.set OUT_3__0__PA__CFG7, CYREG_UDB_PA1_CFG7
.set OUT_3__0__PA__CFG8, CYREG_UDB_PA1_CFG8
.set OUT_3__0__PA__CFG9, CYREG_UDB_PA1_CFG9
.set OUT_3__0__PC, CYREG_PRT1_PC
.set OUT_3__0__PC2, CYREG_PRT1_PC2
.set OUT_3__0__PORT, 1
.set OUT_3__0__PS, CYREG_PRT1_PS
.set OUT_3__0__SHIFT, 3
.set OUT_3__DR, CYREG_PRT1_DR
.set OUT_3__INTCFG, CYREG_PRT1_INTCFG
.set OUT_3__INTSTAT, CYREG_PRT1_INTSTAT
.set OUT_3__MASK, 0x08
.set OUT_3__PA__CFG0, CYREG_UDB_PA1_CFG0
.set OUT_3__PA__CFG1, CYREG_UDB_PA1_CFG1
.set OUT_3__PA__CFG10, CYREG_UDB_PA1_CFG10
.set OUT_3__PA__CFG11, CYREG_UDB_PA1_CFG11
.set OUT_3__PA__CFG12, CYREG_UDB_PA1_CFG12
.set OUT_3__PA__CFG13, CYREG_UDB_PA1_CFG13
.set OUT_3__PA__CFG14, CYREG_UDB_PA1_CFG14
.set OUT_3__PA__CFG2, CYREG_UDB_PA1_CFG2
.set OUT_3__PA__CFG3, CYREG_UDB_PA1_CFG3
.set OUT_3__PA__CFG4, CYREG_UDB_PA1_CFG4
.set OUT_3__PA__CFG5, CYREG_UDB_PA1_CFG5
.set OUT_3__PA__CFG6, CYREG_UDB_PA1_CFG6
.set OUT_3__PA__CFG7, CYREG_UDB_PA1_CFG7
.set OUT_3__PA__CFG8, CYREG_UDB_PA1_CFG8
.set OUT_3__PA__CFG9, CYREG_UDB_PA1_CFG9
.set OUT_3__PC, CYREG_PRT1_PC
.set OUT_3__PC2, CYREG_PRT1_PC2
.set OUT_3__PORT, 1
.set OUT_3__PS, CYREG_PRT1_PS
.set OUT_3__SHIFT, 3

/* Miscellaneous */
.set CYDEV_BCLK__HFCLK__HZ, 24000000
.set CYDEV_BCLK__HFCLK__KHZ, 24000
.set CYDEV_BCLK__HFCLK__MHZ, 24
.set CYDEV_BCLK__SYSCLK__HZ, 24000000
.set CYDEV_BCLK__SYSCLK__KHZ, 24000
.set CYDEV_BCLK__SYSCLK__MHZ, 24
.set CYDEV_CHIP_DIE_GEN4, 2
.set CYDEV_CHIP_DIE_LEOPARD, 1
.set CYDEV_CHIP_DIE_PANTHER, 12
.set CYDEV_CHIP_DIE_PSOC4A, 5
.set CYDEV_CHIP_DIE_PSOC5LP, 11
.set CYDEV_CHIP_DIE_UNKNOWN, 0
.set CYDEV_CHIP_FAMILY_PSOC3, 1
.set CYDEV_CHIP_FAMILY_PSOC4, 2
.set CYDEV_CHIP_FAMILY_PSOC5, 3
.set CYDEV_CHIP_FAMILY_UNKNOWN, 0
.set CYDEV_CHIP_FAMILY_USED, CYDEV_CHIP_FAMILY_PSOC4
.set CYDEV_CHIP_JTAG_ID, 0x04C81193
.set CYDEV_CHIP_MEMBER_3A, 1
.set CYDEV_CHIP_MEMBER_4A, 5
.set CYDEV_CHIP_MEMBER_4C, 9
.set CYDEV_CHIP_MEMBER_4D, 3
.set CYDEV_CHIP_MEMBER_4E, 4
.set CYDEV_CHIP_MEMBER_4F, 6
.set CYDEV_CHIP_MEMBER_4G, 2
.set CYDEV_CHIP_MEMBER_4L, 8
.set CYDEV_CHIP_MEMBER_4M, 7
.set CYDEV_CHIP_MEMBER_5A, 11
.set CYDEV_CHIP_MEMBER_5B, 10
.set CYDEV_CHIP_MEMBER_UNKNOWN, 0
.set CYDEV_CHIP_MEMBER_USED, CYDEV_CHIP_MEMBER_4A
.set CYDEV_CHIP_DIE_EXPECT, CYDEV_CHIP_MEMBER_USED
.set CYDEV_CHIP_DIE_ACTUAL, CYDEV_CHIP_DIE_EXPECT
.set CYDEV_CHIP_REV_GEN4_ES, 17
.set CYDEV_CHIP_REV_GEN4_ES2, 33
.set CYDEV_CHIP_REV_GEN4_PRODUCTION, 17
.set CYDEV_CHIP_REV_LEOPARD_ES1, 0
.set CYDEV_CHIP_REV_LEOPARD_ES2, 1
.set CYDEV_CHIP_REV_LEOPARD_ES3, 3
.set CYDEV_CHIP_REV_LEOPARD_PRODUCTION, 3
.set CYDEV_CHIP_REV_PANTHER_ES0, 0
.set CYDEV_CHIP_REV_PANTHER_ES1, 1
.set CYDEV_CHIP_REV_PANTHER_PRODUCTION, 1
.set CYDEV_CHIP_REV_PSOC4A_ES0, 17
.set CYDEV_CHIP_REV_PSOC4A_PRODUCTION, 17
.set CYDEV_CHIP_REV_PSOC5LP_ES0, 0
.set CYDEV_CHIP_REV_PSOC5LP_PRODUCTION, 0
.set CYDEV_CHIP_REVISION_3A_ES1, 0
.set CYDEV_CHIP_REVISION_3A_ES2, 1
.set CYDEV_CHIP_REVISION_3A_ES3, 3
.set CYDEV_CHIP_REVISION_3A_PRODUCTION, 3
.set CYDEV_CHIP_REVISION_4A_ES0, 17
.set CYDEV_CHIP_REVISION_4A_PRODUCTION, 17
.set CYDEV_CHIP_REVISION_4C_PRODUCTION, 0
.set CYDEV_CHIP_REVISION_4D_PRODUCTION, 0
.set CYDEV_CHIP_REVISION_4E_PRODUCTION, 0
.set CYDEV_CHIP_REVISION_4F_PRODUCTION, 0
.set CYDEV_CHIP_REVISION_4F_PRODUCTION_256K, 0
.set CYDEV_CHIP_REVISION_4G_ES, 17
.set CYDEV_CHIP_REVISION_4G_ES2, 33
.set CYDEV_CHIP_REVISION_4G_PRODUCTION, 17
.set CYDEV_CHIP_REVISION_4L_PRODUCTION, 0
.set CYDEV_CHIP_REVISION_4M_PRODUCTION, 0
.set CYDEV_CHIP_REVISION_5A_ES0, 0
.set CYDEV_CHIP_REVISION_5A_ES1, 1
.set CYDEV_CHIP_REVISION_5A_PRODUCTION, 1
.set CYDEV_CHIP_REVISION_5B_ES0, 0
.set CYDEV_CHIP_REVISION_5B_PRODUCTION, 0
.set CYDEV_CHIP_REVISION_USED, CYDEV_CHIP_REVISION_4A_PRODUCTION
.set CYDEV_CHIP_REV_EXPECT, CYDEV_CHIP_REVISION_USED
.set CYDEV_CONFIG_READ_ACCELERATOR, 1
.set CYDEV_CONFIG_UNUSED_IO_AllowButWarn, 0
.set CYDEV_CONFIG_UNUSED_IO, CYDEV_CONFIG_UNUSED_IO_AllowButWarn
.set CYDEV_CONFIG_UNUSED_IO_AllowWithInfo, 1
.set CYDEV_CONFIG_UNUSED_IO_Disallowed, 2
.set CYDEV_CONFIGURATION_COMPRESSED, 1
.set CYDEV_CONFIGURATION_MODE_COMPRESSED, 0
.set CYDEV_CONFIGURATION_MODE, CYDEV_CONFIGURATION_MODE_COMPRESSED
.set CYDEV_CONFIGURATION_MODE_DMA, 2
.set CYDEV_CONFIGURATION_MODE_UNCOMPRESSED, 1
.set CYDEV_DEBUG_PROTECT_KILL, 4
.set CYDEV_DEBUG_PROTECT_OPEN, 1
.set CYDEV_DEBUG_PROTECT, CYDEV_DEBUG_PROTECT_OPEN
.set CYDEV_DEBUG_PROTECT_PROTECTED, 2
.set CYDEV_DEBUGGING_DPS_Disable, 3
.set CYDEV_DEBUGGING_DPS_SWD, 2
.set CYDEV_DEBUGGING_DPS, CYDEV_DEBUGGING_DPS_SWD
.set CYDEV_DEBUGGING_ENABLE, 1
.set CYDEV_DFT_SELECT_CLK0, 1
.set CYDEV_DFT_SELECT_CLK1, 2
.set CYDEV_HEAP_SIZE, 0x80
.set CYDEV_IMO_TRIMMED_BY_WCO, 0
.set CYDEV_PROJ_TYPE, 2
.set CYDEV_PROJ_TYPE_BOOTLOADER, 1
.set CYDEV_PROJ_TYPE_LAUNCHER, 5
.set CYDEV_PROJ_TYPE_LOADABLE, 2
.set CYDEV_PROJ_TYPE_LOADABLEANDBOOTLOADER, 4
.set CYDEV_PROJ_TYPE_MULTIAPPBOOTLOADER, 3
.set CYDEV_PROJ_TYPE_STANDARD, 0
.set CYDEV_STACK_SIZE, 0x0400
.set CYDEV_USE_BUNDLED_CMSIS, 1
.set CYDEV_VARIABLE_VDDA, 1
.set CYDEV_VDDA_MV, 3300
.set CYDEV_VDDD_MV, 3300
.set CYDEV_WDT_GENERATE_ISR, 1
.set CYIPBLOCK_M0S8_CTBM_VERSION, 0
.set CYIPBLOCK_m0s8cpuss_VERSION, 0
.set CYIPBLOCK_m0s8csd_VERSION, 0
.set CYIPBLOCK_m0s8gpio2_VERSION, 0
.set CYIPBLOCK_m0s8hsiom4a_VERSION, 0
.set CYIPBLOCK_m0s8lcd_VERSION, 0
.set CYIPBLOCK_m0s8lpcomp_VERSION, 0
.set CYIPBLOCK_m0s8pclk_VERSION, 0
.set CYIPBLOCK_m0s8sar_VERSION, 0
.set CYIPBLOCK_m0s8scb_VERSION, 0
.set CYIPBLOCK_m0s8srssv2_VERSION, 1
.set CYIPBLOCK_m0s8tcpwm_VERSION, 0
.set CYIPBLOCK_m0s8udbif_VERSION, 0
.set CYIPBLOCK_S8_GPIO_VERSION, 2
.set CYDEV_BOOTLOADER_ENABLE, 0
.endif
