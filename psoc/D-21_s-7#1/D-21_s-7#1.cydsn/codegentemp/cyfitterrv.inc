    IF :LNOT::DEF:INCLUDED_CYFITTERRV_INC
INCLUDED_CYFITTERRV_INC EQU 1
    GET cydevicerv_trm.inc

; LED_1
LED_1__0__DM__MASK EQU 0x1C0000
LED_1__0__DM__SHIFT EQU 18
LED_1__0__DR EQU CYREG_PRT1_DR
LED_1__0__HSIOM EQU CYREG_HSIOM_PORT_SEL1
LED_1__0__HSIOM_MASK EQU 0x0F000000
LED_1__0__HSIOM_SHIFT EQU 24
LED_1__0__INTCFG EQU CYREG_PRT1_INTCFG
LED_1__0__INTSTAT EQU CYREG_PRT1_INTSTAT
LED_1__0__MASK EQU 0x40
LED_1__0__OUT_SEL EQU CYREG_UDB_PA1_CFG10
LED_1__0__OUT_SEL_SHIFT EQU 12
LED_1__0__OUT_SEL_VAL EQU 0
LED_1__0__PA__CFG0 EQU CYREG_UDB_PA1_CFG0
LED_1__0__PA__CFG1 EQU CYREG_UDB_PA1_CFG1
LED_1__0__PA__CFG10 EQU CYREG_UDB_PA1_CFG10
LED_1__0__PA__CFG11 EQU CYREG_UDB_PA1_CFG11
LED_1__0__PA__CFG12 EQU CYREG_UDB_PA1_CFG12
LED_1__0__PA__CFG13 EQU CYREG_UDB_PA1_CFG13
LED_1__0__PA__CFG14 EQU CYREG_UDB_PA1_CFG14
LED_1__0__PA__CFG2 EQU CYREG_UDB_PA1_CFG2
LED_1__0__PA__CFG3 EQU CYREG_UDB_PA1_CFG3
LED_1__0__PA__CFG4 EQU CYREG_UDB_PA1_CFG4
LED_1__0__PA__CFG5 EQU CYREG_UDB_PA1_CFG5
LED_1__0__PA__CFG6 EQU CYREG_UDB_PA1_CFG6
LED_1__0__PA__CFG7 EQU CYREG_UDB_PA1_CFG7
LED_1__0__PA__CFG8 EQU CYREG_UDB_PA1_CFG8
LED_1__0__PA__CFG9 EQU CYREG_UDB_PA1_CFG9
LED_1__0__PC EQU CYREG_PRT1_PC
LED_1__0__PC2 EQU CYREG_PRT1_PC2
LED_1__0__PORT EQU 1
LED_1__0__PS EQU CYREG_PRT1_PS
LED_1__0__SHIFT EQU 6
LED_1__DR EQU CYREG_PRT1_DR
LED_1__INTCFG EQU CYREG_PRT1_INTCFG
LED_1__INTSTAT EQU CYREG_PRT1_INTSTAT
LED_1__MASK EQU 0x40
LED_1__PA__CFG0 EQU CYREG_UDB_PA1_CFG0
LED_1__PA__CFG1 EQU CYREG_UDB_PA1_CFG1
LED_1__PA__CFG10 EQU CYREG_UDB_PA1_CFG10
LED_1__PA__CFG11 EQU CYREG_UDB_PA1_CFG11
LED_1__PA__CFG12 EQU CYREG_UDB_PA1_CFG12
LED_1__PA__CFG13 EQU CYREG_UDB_PA1_CFG13
LED_1__PA__CFG14 EQU CYREG_UDB_PA1_CFG14
LED_1__PA__CFG2 EQU CYREG_UDB_PA1_CFG2
LED_1__PA__CFG3 EQU CYREG_UDB_PA1_CFG3
LED_1__PA__CFG4 EQU CYREG_UDB_PA1_CFG4
LED_1__PA__CFG5 EQU CYREG_UDB_PA1_CFG5
LED_1__PA__CFG6 EQU CYREG_UDB_PA1_CFG6
LED_1__PA__CFG7 EQU CYREG_UDB_PA1_CFG7
LED_1__PA__CFG8 EQU CYREG_UDB_PA1_CFG8
LED_1__PA__CFG9 EQU CYREG_UDB_PA1_CFG9
LED_1__PC EQU CYREG_PRT1_PC
LED_1__PC2 EQU CYREG_PRT1_PC2
LED_1__PORT EQU 1
LED_1__PS EQU CYREG_PRT1_PS
LED_1__SHIFT EQU 6

; PWM_1_PWMUDB
PWM_1_PWMUDB_genblk1_ctrlreg__16BIT_CONTROL_AUX_CTL_REG EQU CYREG_UDB_W16_ACTL_02
PWM_1_PWMUDB_genblk1_ctrlreg__16BIT_CONTROL_CONTROL_REG EQU CYREG_UDB_W16_CTL_02
PWM_1_PWMUDB_genblk1_ctrlreg__16BIT_CONTROL_COUNT_REG EQU CYREG_UDB_W16_CTL_02
PWM_1_PWMUDB_genblk1_ctrlreg__16BIT_COUNT_CONTROL_REG EQU CYREG_UDB_W16_CTL_02
PWM_1_PWMUDB_genblk1_ctrlreg__16BIT_COUNT_COUNT_REG EQU CYREG_UDB_W16_CTL_02
PWM_1_PWMUDB_genblk1_ctrlreg__16BIT_MASK_MASK_REG EQU CYREG_UDB_W16_MSK_02
PWM_1_PWMUDB_genblk1_ctrlreg__16BIT_MASK_PERIOD_REG EQU CYREG_UDB_W16_MSK_02
PWM_1_PWMUDB_genblk1_ctrlreg__16BIT_PERIOD_MASK_REG EQU CYREG_UDB_W16_MSK_02
PWM_1_PWMUDB_genblk1_ctrlreg__16BIT_PERIOD_PERIOD_REG EQU CYREG_UDB_W16_MSK_02
PWM_1_PWMUDB_genblk1_ctrlreg__7__MASK EQU 0x80
PWM_1_PWMUDB_genblk1_ctrlreg__7__POS EQU 7
PWM_1_PWMUDB_genblk1_ctrlreg__CONTROL_AUX_CTL_REG EQU CYREG_UDB_W8_ACTL_02
PWM_1_PWMUDB_genblk1_ctrlreg__CONTROL_REG EQU CYREG_UDB_W8_CTL_02
PWM_1_PWMUDB_genblk1_ctrlreg__CONTROL_ST_REG EQU CYREG_UDB_CAT16_CTL_ST_02
PWM_1_PWMUDB_genblk1_ctrlreg__COUNT_REG EQU CYREG_UDB_W8_CTL_02
PWM_1_PWMUDB_genblk1_ctrlreg__COUNT_ST_REG EQU CYREG_UDB_CAT16_CTL_ST_02
PWM_1_PWMUDB_genblk1_ctrlreg__MASK EQU 0x80
PWM_1_PWMUDB_genblk1_ctrlreg__MASK_CTL_AUX_CTL_REG EQU CYREG_UDB_CAT16_ACTL_MSK_02
PWM_1_PWMUDB_genblk1_ctrlreg__PER_CTL_AUX_CTL_REG EQU CYREG_UDB_CAT16_ACTL_MSK_02
PWM_1_PWMUDB_genblk1_ctrlreg__PERIOD_REG EQU CYREG_UDB_W8_MSK_02
PWM_1_PWMUDB_genblk8_stsreg__0__MASK EQU 0x01
PWM_1_PWMUDB_genblk8_stsreg__0__POS EQU 0
PWM_1_PWMUDB_genblk8_stsreg__16BIT_STATUS_AUX_CTL_REG EQU CYREG_UDB_W16_ACTL_02
PWM_1_PWMUDB_genblk8_stsreg__16BIT_STATUS_REG EQU CYREG_UDB_W16_ST_02
PWM_1_PWMUDB_genblk8_stsreg__2__MASK EQU 0x04
PWM_1_PWMUDB_genblk8_stsreg__2__POS EQU 2
PWM_1_PWMUDB_genblk8_stsreg__3__MASK EQU 0x08
PWM_1_PWMUDB_genblk8_stsreg__3__POS EQU 3
PWM_1_PWMUDB_genblk8_stsreg__MASK EQU 0x0D
PWM_1_PWMUDB_genblk8_stsreg__MASK_REG EQU CYREG_UDB_W8_MSK_02
PWM_1_PWMUDB_genblk8_stsreg__MASK_ST_AUX_CTL_REG EQU CYREG_UDB_CAT16_ACTL_MSK_02
PWM_1_PWMUDB_genblk8_stsreg__PER_ST_AUX_CTL_REG EQU CYREG_UDB_CAT16_ACTL_MSK_02
PWM_1_PWMUDB_genblk8_stsreg__STATUS_AUX_CTL_REG EQU CYREG_UDB_W8_ACTL_02
PWM_1_PWMUDB_genblk8_stsreg__STATUS_CNT_REG EQU CYREG_UDB_CAT16_CTL_ST_02
PWM_1_PWMUDB_genblk8_stsreg__STATUS_CONTROL_REG EQU CYREG_UDB_CAT16_CTL_ST_02
PWM_1_PWMUDB_genblk8_stsreg__STATUS_REG EQU CYREG_UDB_W8_ST_02
PWM_1_PWMUDB_sP8_pwmdp_u0__16BIT_A0_REG EQU CYREG_UDB_W16_A0_02
PWM_1_PWMUDB_sP8_pwmdp_u0__16BIT_A1_REG EQU CYREG_UDB_W16_A1_02
PWM_1_PWMUDB_sP8_pwmdp_u0__16BIT_D0_REG EQU CYREG_UDB_W16_D0_02
PWM_1_PWMUDB_sP8_pwmdp_u0__16BIT_D1_REG EQU CYREG_UDB_W16_D1_02
PWM_1_PWMUDB_sP8_pwmdp_u0__16BIT_DP_AUX_CTL_REG EQU CYREG_UDB_W16_ACTL_02
PWM_1_PWMUDB_sP8_pwmdp_u0__16BIT_F0_REG EQU CYREG_UDB_W16_F0_02
PWM_1_PWMUDB_sP8_pwmdp_u0__16BIT_F1_REG EQU CYREG_UDB_W16_F1_02
PWM_1_PWMUDB_sP8_pwmdp_u0__A0_A1_REG EQU CYREG_UDB_CAT16_A_02
PWM_1_PWMUDB_sP8_pwmdp_u0__A0_REG EQU CYREG_UDB_W8_A0_02
PWM_1_PWMUDB_sP8_pwmdp_u0__A1_REG EQU CYREG_UDB_W8_A1_02
PWM_1_PWMUDB_sP8_pwmdp_u0__D0_D1_REG EQU CYREG_UDB_CAT16_D_02
PWM_1_PWMUDB_sP8_pwmdp_u0__D0_REG EQU CYREG_UDB_W8_D0_02
PWM_1_PWMUDB_sP8_pwmdp_u0__D1_REG EQU CYREG_UDB_W8_D1_02
PWM_1_PWMUDB_sP8_pwmdp_u0__DP_AUX_CTL_REG EQU CYREG_UDB_W8_ACTL_02
PWM_1_PWMUDB_sP8_pwmdp_u0__F0_F1_REG EQU CYREG_UDB_CAT16_F_02
PWM_1_PWMUDB_sP8_pwmdp_u0__F0_REG EQU CYREG_UDB_W8_F0_02
PWM_1_PWMUDB_sP8_pwmdp_u0__F1_REG EQU CYREG_UDB_W8_F1_02
PWM_1_PWMUDB_sP8_pwmdp_u0__MSK_DP_AUX_CTL_REG EQU CYREG_UDB_CAT16_ACTL_MSK_02
PWM_1_PWMUDB_sP8_pwmdp_u0__PER_DP_AUX_CTL_REG EQU CYREG_UDB_CAT16_ACTL_MSK_02

; Clock_1
Clock_1__DIVIDER_MASK EQU 0x0000FFFF
Clock_1__ENABLE EQU CYREG_CLK_DIVIDER_C00
Clock_1__ENABLE_MASK EQU 0x80000000
Clock_1__MASK EQU 0x80000000
Clock_1__REGISTER EQU CYREG_CLK_DIVIDER_C00

; CapSense_Cmod
CapSense_Cmod__0__DM__MASK EQU 0x1C0
CapSense_Cmod__0__DM__SHIFT EQU 6
CapSense_Cmod__0__DR EQU CYREG_PRT4_DR
CapSense_Cmod__0__HSIOM EQU CYREG_HSIOM_PORT_SEL4
CapSense_Cmod__0__HSIOM_MASK EQU 0x00000F00
CapSense_Cmod__0__HSIOM_SHIFT EQU 8
CapSense_Cmod__0__INTCFG EQU CYREG_PRT4_INTCFG
CapSense_Cmod__0__INTSTAT EQU CYREG_PRT4_INTSTAT
CapSense_Cmod__0__MASK EQU 0x04
CapSense_Cmod__0__PC EQU CYREG_PRT4_PC
CapSense_Cmod__0__PC2 EQU CYREG_PRT4_PC2
CapSense_Cmod__0__PORT EQU 4
CapSense_Cmod__0__PS EQU CYREG_PRT4_PS
CapSense_Cmod__0__SHIFT EQU 2
CapSense_Cmod__Cmod__DM__MASK EQU 0x1C0
CapSense_Cmod__Cmod__DM__SHIFT EQU 6
CapSense_Cmod__Cmod__DR EQU CYREG_PRT4_DR
CapSense_Cmod__Cmod__INTCFG EQU CYREG_PRT4_INTCFG
CapSense_Cmod__Cmod__INTSTAT EQU CYREG_PRT4_INTSTAT
CapSense_Cmod__Cmod__MASK EQU 0x04
CapSense_Cmod__Cmod__PC EQU CYREG_PRT4_PC
CapSense_Cmod__Cmod__PC2 EQU CYREG_PRT4_PC2
CapSense_Cmod__Cmod__PORT EQU 4
CapSense_Cmod__Cmod__PS EQU CYREG_PRT4_PS
CapSense_Cmod__Cmod__SHIFT EQU 2
CapSense_Cmod__DR EQU CYREG_PRT4_DR
CapSense_Cmod__INTCFG EQU CYREG_PRT4_INTCFG
CapSense_Cmod__INTSTAT EQU CYREG_PRT4_INTSTAT
CapSense_Cmod__MASK EQU 0x04
CapSense_Cmod__PC EQU CYREG_PRT4_PC
CapSense_Cmod__PC2 EQU CYREG_PRT4_PC2
CapSense_Cmod__PORT EQU 4
CapSense_Cmod__PS EQU CYREG_PRT4_PS
CapSense_Cmod__SHIFT EQU 2

; CapSense_CSD_FFB
CapSense_CSD_FFB__CSD_CONFIG EQU CYREG_CSD_CONFIG
CapSense_CSD_FFB__CSD_COUNTER EQU CYREG_CSD_COUNTER
CapSense_CSD_FFB__CSD_ID EQU CYREG_CSD_ID
CapSense_CSD_FFB__CSD_INTR EQU CYREG_CSD_INTR
CapSense_CSD_FFB__CSD_INTR_SET EQU CYREG_CSD_INTR_SET
CapSense_CSD_FFB__CSD_NUMBER EQU 0
CapSense_CSD_FFB__CSD_STATUS EQU CYREG_CSD_STATUS

; CapSense_IDAC1_cy_psoc4_idac
CapSense_IDAC1_cy_psoc4_idac__CONTROL EQU CYREG_CSD_CONFIG
CapSense_IDAC1_cy_psoc4_idac__CSD_IDAC EQU CYREG_CSD_IDAC
CapSense_IDAC1_cy_psoc4_idac__CSD_IDAC_SHIFT EQU 0
CapSense_IDAC1_cy_psoc4_idac__CSD_TRIM1 EQU CYREG_CSD_TRIM1
CapSense_IDAC1_cy_psoc4_idac__CSD_TRIM1_SHIFT EQU 0
CapSense_IDAC1_cy_psoc4_idac__CSD_TRIM2 EQU CYREG_CSD_TRIM2
CapSense_IDAC1_cy_psoc4_idac__CSD_TRIM2_SHIFT EQU 0
CapSense_IDAC1_cy_psoc4_idac__IDAC_NUMBER EQU 1
CapSense_IDAC1_cy_psoc4_idac__POLARITY EQU CYREG_CSD_CONFIG
CapSense_IDAC1_cy_psoc4_idac__POLARITY_SHIFT EQU 16

; CapSense_IDAC2_cy_psoc4_idac
CapSense_IDAC2_cy_psoc4_idac__CONTROL EQU CYREG_CSD_CONFIG
CapSense_IDAC2_cy_psoc4_idac__CSD_IDAC EQU CYREG_CSD_IDAC
CapSense_IDAC2_cy_psoc4_idac__CSD_IDAC_SHIFT EQU 16
CapSense_IDAC2_cy_psoc4_idac__CSD_TRIM1 EQU CYREG_CSD_TRIM1
CapSense_IDAC2_cy_psoc4_idac__CSD_TRIM1_SHIFT EQU 4
CapSense_IDAC2_cy_psoc4_idac__CSD_TRIM2 EQU CYREG_CSD_TRIM2
CapSense_IDAC2_cy_psoc4_idac__CSD_TRIM2_SHIFT EQU 4
CapSense_IDAC2_cy_psoc4_idac__IDAC_NUMBER EQU 2
CapSense_IDAC2_cy_psoc4_idac__POLARITY EQU CYREG_CSD_CONFIG
CapSense_IDAC2_cy_psoc4_idac__POLARITY_SHIFT EQU 17

; CapSense_ISR
CapSense_ISR__INTC_CLR_EN_REG EQU CYREG_CM0_ICER
CapSense_ISR__INTC_CLR_PD_REG EQU CYREG_CM0_ICPR
CapSense_ISR__INTC_MASK EQU 0x8000
CapSense_ISR__INTC_NUMBER EQU 15
CapSense_ISR__INTC_PRIOR_MASK EQU 0xC0000000
CapSense_ISR__INTC_PRIOR_NUM EQU 3
CapSense_ISR__INTC_PRIOR_REG EQU CYREG_CM0_IPR3
CapSense_ISR__INTC_SET_EN_REG EQU CYREG_CM0_ISER
CapSense_ISR__INTC_SET_PD_REG EQU CYREG_CM0_ISPR

; CapSense_SampleClk
CapSense_SampleClk__DIVIDER_MASK EQU 0x0000FFFF
CapSense_SampleClk__ENABLE EQU CYREG_CLK_DIVIDER_A00
CapSense_SampleClk__ENABLE_MASK EQU 0x80000000
CapSense_SampleClk__MASK EQU 0x80000000
CapSense_SampleClk__REGISTER EQU CYREG_CLK_DIVIDER_A00

; CapSense_SenseClk
CapSense_SenseClk__DIVIDER_MASK EQU 0x0000FFFF
CapSense_SenseClk__ENABLE EQU CYREG_CLK_DIVIDER_B00
CapSense_SenseClk__ENABLE_MASK EQU 0x80000000
CapSense_SenseClk__MASK EQU 0x80000000
CapSense_SenseClk__REGISTER EQU CYREG_CLK_DIVIDER_B00

; CapSense_Sns
CapSense_Sns__0__DM__MASK EQU 0x38
CapSense_Sns__0__DM__SHIFT EQU 3
CapSense_Sns__0__DR EQU CYREG_PRT1_DR
CapSense_Sns__0__HSIOM EQU CYREG_HSIOM_PORT_SEL1
CapSense_Sns__0__HSIOM_MASK EQU 0x000000F0
CapSense_Sns__0__HSIOM_SHIFT EQU 4
CapSense_Sns__0__INTCFG EQU CYREG_PRT1_INTCFG
CapSense_Sns__0__INTSTAT EQU CYREG_PRT1_INTSTAT
CapSense_Sns__0__MASK EQU 0x02
CapSense_Sns__0__PA__CFG0 EQU CYREG_UDB_PA1_CFG0
CapSense_Sns__0__PA__CFG1 EQU CYREG_UDB_PA1_CFG1
CapSense_Sns__0__PA__CFG10 EQU CYREG_UDB_PA1_CFG10
CapSense_Sns__0__PA__CFG11 EQU CYREG_UDB_PA1_CFG11
CapSense_Sns__0__PA__CFG12 EQU CYREG_UDB_PA1_CFG12
CapSense_Sns__0__PA__CFG13 EQU CYREG_UDB_PA1_CFG13
CapSense_Sns__0__PA__CFG14 EQU CYREG_UDB_PA1_CFG14
CapSense_Sns__0__PA__CFG2 EQU CYREG_UDB_PA1_CFG2
CapSense_Sns__0__PA__CFG3 EQU CYREG_UDB_PA1_CFG3
CapSense_Sns__0__PA__CFG4 EQU CYREG_UDB_PA1_CFG4
CapSense_Sns__0__PA__CFG5 EQU CYREG_UDB_PA1_CFG5
CapSense_Sns__0__PA__CFG6 EQU CYREG_UDB_PA1_CFG6
CapSense_Sns__0__PA__CFG7 EQU CYREG_UDB_PA1_CFG7
CapSense_Sns__0__PA__CFG8 EQU CYREG_UDB_PA1_CFG8
CapSense_Sns__0__PA__CFG9 EQU CYREG_UDB_PA1_CFG9
CapSense_Sns__0__PC EQU CYREG_PRT1_PC
CapSense_Sns__0__PC2 EQU CYREG_PRT1_PC2
CapSense_Sns__0__PORT EQU 1
CapSense_Sns__0__PS EQU CYREG_PRT1_PS
CapSense_Sns__0__SHIFT EQU 1
CapSense_Sns__1__DM__MASK EQU 0x1C0
CapSense_Sns__1__DM__SHIFT EQU 6
CapSense_Sns__1__DR EQU CYREG_PRT1_DR
CapSense_Sns__1__HSIOM EQU CYREG_HSIOM_PORT_SEL1
CapSense_Sns__1__HSIOM_MASK EQU 0x00000F00
CapSense_Sns__1__HSIOM_SHIFT EQU 8
CapSense_Sns__1__INTCFG EQU CYREG_PRT1_INTCFG
CapSense_Sns__1__INTSTAT EQU CYREG_PRT1_INTSTAT
CapSense_Sns__1__MASK EQU 0x04
CapSense_Sns__1__PA__CFG0 EQU CYREG_UDB_PA1_CFG0
CapSense_Sns__1__PA__CFG1 EQU CYREG_UDB_PA1_CFG1
CapSense_Sns__1__PA__CFG10 EQU CYREG_UDB_PA1_CFG10
CapSense_Sns__1__PA__CFG11 EQU CYREG_UDB_PA1_CFG11
CapSense_Sns__1__PA__CFG12 EQU CYREG_UDB_PA1_CFG12
CapSense_Sns__1__PA__CFG13 EQU CYREG_UDB_PA1_CFG13
CapSense_Sns__1__PA__CFG14 EQU CYREG_UDB_PA1_CFG14
CapSense_Sns__1__PA__CFG2 EQU CYREG_UDB_PA1_CFG2
CapSense_Sns__1__PA__CFG3 EQU CYREG_UDB_PA1_CFG3
CapSense_Sns__1__PA__CFG4 EQU CYREG_UDB_PA1_CFG4
CapSense_Sns__1__PA__CFG5 EQU CYREG_UDB_PA1_CFG5
CapSense_Sns__1__PA__CFG6 EQU CYREG_UDB_PA1_CFG6
CapSense_Sns__1__PA__CFG7 EQU CYREG_UDB_PA1_CFG7
CapSense_Sns__1__PA__CFG8 EQU CYREG_UDB_PA1_CFG8
CapSense_Sns__1__PA__CFG9 EQU CYREG_UDB_PA1_CFG9
CapSense_Sns__1__PC EQU CYREG_PRT1_PC
CapSense_Sns__1__PC2 EQU CYREG_PRT1_PC2
CapSense_Sns__1__PORT EQU 1
CapSense_Sns__1__PS EQU CYREG_PRT1_PS
CapSense_Sns__1__SHIFT EQU 2
CapSense_Sns__2__DM__MASK EQU 0xE00
CapSense_Sns__2__DM__SHIFT EQU 9
CapSense_Sns__2__DR EQU CYREG_PRT1_DR
CapSense_Sns__2__HSIOM EQU CYREG_HSIOM_PORT_SEL1
CapSense_Sns__2__HSIOM_MASK EQU 0x0000F000
CapSense_Sns__2__HSIOM_SHIFT EQU 12
CapSense_Sns__2__INTCFG EQU CYREG_PRT1_INTCFG
CapSense_Sns__2__INTSTAT EQU CYREG_PRT1_INTSTAT
CapSense_Sns__2__MASK EQU 0x08
CapSense_Sns__2__PA__CFG0 EQU CYREG_UDB_PA1_CFG0
CapSense_Sns__2__PA__CFG1 EQU CYREG_UDB_PA1_CFG1
CapSense_Sns__2__PA__CFG10 EQU CYREG_UDB_PA1_CFG10
CapSense_Sns__2__PA__CFG11 EQU CYREG_UDB_PA1_CFG11
CapSense_Sns__2__PA__CFG12 EQU CYREG_UDB_PA1_CFG12
CapSense_Sns__2__PA__CFG13 EQU CYREG_UDB_PA1_CFG13
CapSense_Sns__2__PA__CFG14 EQU CYREG_UDB_PA1_CFG14
CapSense_Sns__2__PA__CFG2 EQU CYREG_UDB_PA1_CFG2
CapSense_Sns__2__PA__CFG3 EQU CYREG_UDB_PA1_CFG3
CapSense_Sns__2__PA__CFG4 EQU CYREG_UDB_PA1_CFG4
CapSense_Sns__2__PA__CFG5 EQU CYREG_UDB_PA1_CFG5
CapSense_Sns__2__PA__CFG6 EQU CYREG_UDB_PA1_CFG6
CapSense_Sns__2__PA__CFG7 EQU CYREG_UDB_PA1_CFG7
CapSense_Sns__2__PA__CFG8 EQU CYREG_UDB_PA1_CFG8
CapSense_Sns__2__PA__CFG9 EQU CYREG_UDB_PA1_CFG9
CapSense_Sns__2__PC EQU CYREG_PRT1_PC
CapSense_Sns__2__PC2 EQU CYREG_PRT1_PC2
CapSense_Sns__2__PORT EQU 1
CapSense_Sns__2__PS EQU CYREG_PRT1_PS
CapSense_Sns__2__SHIFT EQU 3
CapSense_Sns__3__DM__MASK EQU 0x7000
CapSense_Sns__3__DM__SHIFT EQU 12
CapSense_Sns__3__DR EQU CYREG_PRT1_DR
CapSense_Sns__3__HSIOM EQU CYREG_HSIOM_PORT_SEL1
CapSense_Sns__3__HSIOM_MASK EQU 0x000F0000
CapSense_Sns__3__HSIOM_SHIFT EQU 16
CapSense_Sns__3__INTCFG EQU CYREG_PRT1_INTCFG
CapSense_Sns__3__INTSTAT EQU CYREG_PRT1_INTSTAT
CapSense_Sns__3__MASK EQU 0x10
CapSense_Sns__3__PA__CFG0 EQU CYREG_UDB_PA1_CFG0
CapSense_Sns__3__PA__CFG1 EQU CYREG_UDB_PA1_CFG1
CapSense_Sns__3__PA__CFG10 EQU CYREG_UDB_PA1_CFG10
CapSense_Sns__3__PA__CFG11 EQU CYREG_UDB_PA1_CFG11
CapSense_Sns__3__PA__CFG12 EQU CYREG_UDB_PA1_CFG12
CapSense_Sns__3__PA__CFG13 EQU CYREG_UDB_PA1_CFG13
CapSense_Sns__3__PA__CFG14 EQU CYREG_UDB_PA1_CFG14
CapSense_Sns__3__PA__CFG2 EQU CYREG_UDB_PA1_CFG2
CapSense_Sns__3__PA__CFG3 EQU CYREG_UDB_PA1_CFG3
CapSense_Sns__3__PA__CFG4 EQU CYREG_UDB_PA1_CFG4
CapSense_Sns__3__PA__CFG5 EQU CYREG_UDB_PA1_CFG5
CapSense_Sns__3__PA__CFG6 EQU CYREG_UDB_PA1_CFG6
CapSense_Sns__3__PA__CFG7 EQU CYREG_UDB_PA1_CFG7
CapSense_Sns__3__PA__CFG8 EQU CYREG_UDB_PA1_CFG8
CapSense_Sns__3__PA__CFG9 EQU CYREG_UDB_PA1_CFG9
CapSense_Sns__3__PC EQU CYREG_PRT1_PC
CapSense_Sns__3__PC2 EQU CYREG_PRT1_PC2
CapSense_Sns__3__PORT EQU 1
CapSense_Sns__3__PS EQU CYREG_PRT1_PS
CapSense_Sns__3__SHIFT EQU 4
CapSense_Sns__4__DM__MASK EQU 0x38000
CapSense_Sns__4__DM__SHIFT EQU 15
CapSense_Sns__4__DR EQU CYREG_PRT1_DR
CapSense_Sns__4__HSIOM EQU CYREG_HSIOM_PORT_SEL1
CapSense_Sns__4__HSIOM_MASK EQU 0x00F00000
CapSense_Sns__4__HSIOM_SHIFT EQU 20
CapSense_Sns__4__INTCFG EQU CYREG_PRT1_INTCFG
CapSense_Sns__4__INTSTAT EQU CYREG_PRT1_INTSTAT
CapSense_Sns__4__MASK EQU 0x20
CapSense_Sns__4__PA__CFG0 EQU CYREG_UDB_PA1_CFG0
CapSense_Sns__4__PA__CFG1 EQU CYREG_UDB_PA1_CFG1
CapSense_Sns__4__PA__CFG10 EQU CYREG_UDB_PA1_CFG10
CapSense_Sns__4__PA__CFG11 EQU CYREG_UDB_PA1_CFG11
CapSense_Sns__4__PA__CFG12 EQU CYREG_UDB_PA1_CFG12
CapSense_Sns__4__PA__CFG13 EQU CYREG_UDB_PA1_CFG13
CapSense_Sns__4__PA__CFG14 EQU CYREG_UDB_PA1_CFG14
CapSense_Sns__4__PA__CFG2 EQU CYREG_UDB_PA1_CFG2
CapSense_Sns__4__PA__CFG3 EQU CYREG_UDB_PA1_CFG3
CapSense_Sns__4__PA__CFG4 EQU CYREG_UDB_PA1_CFG4
CapSense_Sns__4__PA__CFG5 EQU CYREG_UDB_PA1_CFG5
CapSense_Sns__4__PA__CFG6 EQU CYREG_UDB_PA1_CFG6
CapSense_Sns__4__PA__CFG7 EQU CYREG_UDB_PA1_CFG7
CapSense_Sns__4__PA__CFG8 EQU CYREG_UDB_PA1_CFG8
CapSense_Sns__4__PA__CFG9 EQU CYREG_UDB_PA1_CFG9
CapSense_Sns__4__PC EQU CYREG_PRT1_PC
CapSense_Sns__4__PC2 EQU CYREG_PRT1_PC2
CapSense_Sns__4__PORT EQU 1
CapSense_Sns__4__PS EQU CYREG_PRT1_PS
CapSense_Sns__4__SHIFT EQU 5
CapSense_Sns__DR EQU CYREG_PRT1_DR
CapSense_Sns__INTCFG EQU CYREG_PRT1_INTCFG
CapSense_Sns__INTSTAT EQU CYREG_PRT1_INTSTAT
CapSense_Sns__LinearSlider0_e0__LS__DM__MASK EQU 0x38
CapSense_Sns__LinearSlider0_e0__LS__DM__SHIFT EQU 3
CapSense_Sns__LinearSlider0_e0__LS__DR EQU CYREG_PRT1_DR
CapSense_Sns__LinearSlider0_e0__LS__INTCFG EQU CYREG_PRT1_INTCFG
CapSense_Sns__LinearSlider0_e0__LS__INTSTAT EQU CYREG_PRT1_INTSTAT
CapSense_Sns__LinearSlider0_e0__LS__MASK EQU 0x02
CapSense_Sns__LinearSlider0_e0__LS__PA__CFG0 EQU CYREG_UDB_PA1_CFG0
CapSense_Sns__LinearSlider0_e0__LS__PA__CFG1 EQU CYREG_UDB_PA1_CFG1
CapSense_Sns__LinearSlider0_e0__LS__PA__CFG10 EQU CYREG_UDB_PA1_CFG10
CapSense_Sns__LinearSlider0_e0__LS__PA__CFG11 EQU CYREG_UDB_PA1_CFG11
CapSense_Sns__LinearSlider0_e0__LS__PA__CFG12 EQU CYREG_UDB_PA1_CFG12
CapSense_Sns__LinearSlider0_e0__LS__PA__CFG13 EQU CYREG_UDB_PA1_CFG13
CapSense_Sns__LinearSlider0_e0__LS__PA__CFG14 EQU CYREG_UDB_PA1_CFG14
CapSense_Sns__LinearSlider0_e0__LS__PA__CFG2 EQU CYREG_UDB_PA1_CFG2
CapSense_Sns__LinearSlider0_e0__LS__PA__CFG3 EQU CYREG_UDB_PA1_CFG3
CapSense_Sns__LinearSlider0_e0__LS__PA__CFG4 EQU CYREG_UDB_PA1_CFG4
CapSense_Sns__LinearSlider0_e0__LS__PA__CFG5 EQU CYREG_UDB_PA1_CFG5
CapSense_Sns__LinearSlider0_e0__LS__PA__CFG6 EQU CYREG_UDB_PA1_CFG6
CapSense_Sns__LinearSlider0_e0__LS__PA__CFG7 EQU CYREG_UDB_PA1_CFG7
CapSense_Sns__LinearSlider0_e0__LS__PA__CFG8 EQU CYREG_UDB_PA1_CFG8
CapSense_Sns__LinearSlider0_e0__LS__PA__CFG9 EQU CYREG_UDB_PA1_CFG9
CapSense_Sns__LinearSlider0_e0__LS__PC EQU CYREG_PRT1_PC
CapSense_Sns__LinearSlider0_e0__LS__PC2 EQU CYREG_PRT1_PC2
CapSense_Sns__LinearSlider0_e0__LS__PORT EQU 1
CapSense_Sns__LinearSlider0_e0__LS__PS EQU CYREG_PRT1_PS
CapSense_Sns__LinearSlider0_e0__LS__SHIFT EQU 1
CapSense_Sns__LinearSlider0_e1__LS__DM__MASK EQU 0x1C0
CapSense_Sns__LinearSlider0_e1__LS__DM__SHIFT EQU 6
CapSense_Sns__LinearSlider0_e1__LS__DR EQU CYREG_PRT1_DR
CapSense_Sns__LinearSlider0_e1__LS__INTCFG EQU CYREG_PRT1_INTCFG
CapSense_Sns__LinearSlider0_e1__LS__INTSTAT EQU CYREG_PRT1_INTSTAT
CapSense_Sns__LinearSlider0_e1__LS__MASK EQU 0x04
CapSense_Sns__LinearSlider0_e1__LS__PA__CFG0 EQU CYREG_UDB_PA1_CFG0
CapSense_Sns__LinearSlider0_e1__LS__PA__CFG1 EQU CYREG_UDB_PA1_CFG1
CapSense_Sns__LinearSlider0_e1__LS__PA__CFG10 EQU CYREG_UDB_PA1_CFG10
CapSense_Sns__LinearSlider0_e1__LS__PA__CFG11 EQU CYREG_UDB_PA1_CFG11
CapSense_Sns__LinearSlider0_e1__LS__PA__CFG12 EQU CYREG_UDB_PA1_CFG12
CapSense_Sns__LinearSlider0_e1__LS__PA__CFG13 EQU CYREG_UDB_PA1_CFG13
CapSense_Sns__LinearSlider0_e1__LS__PA__CFG14 EQU CYREG_UDB_PA1_CFG14
CapSense_Sns__LinearSlider0_e1__LS__PA__CFG2 EQU CYREG_UDB_PA1_CFG2
CapSense_Sns__LinearSlider0_e1__LS__PA__CFG3 EQU CYREG_UDB_PA1_CFG3
CapSense_Sns__LinearSlider0_e1__LS__PA__CFG4 EQU CYREG_UDB_PA1_CFG4
CapSense_Sns__LinearSlider0_e1__LS__PA__CFG5 EQU CYREG_UDB_PA1_CFG5
CapSense_Sns__LinearSlider0_e1__LS__PA__CFG6 EQU CYREG_UDB_PA1_CFG6
CapSense_Sns__LinearSlider0_e1__LS__PA__CFG7 EQU CYREG_UDB_PA1_CFG7
CapSense_Sns__LinearSlider0_e1__LS__PA__CFG8 EQU CYREG_UDB_PA1_CFG8
CapSense_Sns__LinearSlider0_e1__LS__PA__CFG9 EQU CYREG_UDB_PA1_CFG9
CapSense_Sns__LinearSlider0_e1__LS__PC EQU CYREG_PRT1_PC
CapSense_Sns__LinearSlider0_e1__LS__PC2 EQU CYREG_PRT1_PC2
CapSense_Sns__LinearSlider0_e1__LS__PORT EQU 1
CapSense_Sns__LinearSlider0_e1__LS__PS EQU CYREG_PRT1_PS
CapSense_Sns__LinearSlider0_e1__LS__SHIFT EQU 2
CapSense_Sns__LinearSlider0_e2__LS__DM__MASK EQU 0xE00
CapSense_Sns__LinearSlider0_e2__LS__DM__SHIFT EQU 9
CapSense_Sns__LinearSlider0_e2__LS__DR EQU CYREG_PRT1_DR
CapSense_Sns__LinearSlider0_e2__LS__INTCFG EQU CYREG_PRT1_INTCFG
CapSense_Sns__LinearSlider0_e2__LS__INTSTAT EQU CYREG_PRT1_INTSTAT
CapSense_Sns__LinearSlider0_e2__LS__MASK EQU 0x08
CapSense_Sns__LinearSlider0_e2__LS__PA__CFG0 EQU CYREG_UDB_PA1_CFG0
CapSense_Sns__LinearSlider0_e2__LS__PA__CFG1 EQU CYREG_UDB_PA1_CFG1
CapSense_Sns__LinearSlider0_e2__LS__PA__CFG10 EQU CYREG_UDB_PA1_CFG10
CapSense_Sns__LinearSlider0_e2__LS__PA__CFG11 EQU CYREG_UDB_PA1_CFG11
CapSense_Sns__LinearSlider0_e2__LS__PA__CFG12 EQU CYREG_UDB_PA1_CFG12
CapSense_Sns__LinearSlider0_e2__LS__PA__CFG13 EQU CYREG_UDB_PA1_CFG13
CapSense_Sns__LinearSlider0_e2__LS__PA__CFG14 EQU CYREG_UDB_PA1_CFG14
CapSense_Sns__LinearSlider0_e2__LS__PA__CFG2 EQU CYREG_UDB_PA1_CFG2
CapSense_Sns__LinearSlider0_e2__LS__PA__CFG3 EQU CYREG_UDB_PA1_CFG3
CapSense_Sns__LinearSlider0_e2__LS__PA__CFG4 EQU CYREG_UDB_PA1_CFG4
CapSense_Sns__LinearSlider0_e2__LS__PA__CFG5 EQU CYREG_UDB_PA1_CFG5
CapSense_Sns__LinearSlider0_e2__LS__PA__CFG6 EQU CYREG_UDB_PA1_CFG6
CapSense_Sns__LinearSlider0_e2__LS__PA__CFG7 EQU CYREG_UDB_PA1_CFG7
CapSense_Sns__LinearSlider0_e2__LS__PA__CFG8 EQU CYREG_UDB_PA1_CFG8
CapSense_Sns__LinearSlider0_e2__LS__PA__CFG9 EQU CYREG_UDB_PA1_CFG9
CapSense_Sns__LinearSlider0_e2__LS__PC EQU CYREG_PRT1_PC
CapSense_Sns__LinearSlider0_e2__LS__PC2 EQU CYREG_PRT1_PC2
CapSense_Sns__LinearSlider0_e2__LS__PORT EQU 1
CapSense_Sns__LinearSlider0_e2__LS__PS EQU CYREG_PRT1_PS
CapSense_Sns__LinearSlider0_e2__LS__SHIFT EQU 3
CapSense_Sns__LinearSlider0_e3__LS__DM__MASK EQU 0x7000
CapSense_Sns__LinearSlider0_e3__LS__DM__SHIFT EQU 12
CapSense_Sns__LinearSlider0_e3__LS__DR EQU CYREG_PRT1_DR
CapSense_Sns__LinearSlider0_e3__LS__INTCFG EQU CYREG_PRT1_INTCFG
CapSense_Sns__LinearSlider0_e3__LS__INTSTAT EQU CYREG_PRT1_INTSTAT
CapSense_Sns__LinearSlider0_e3__LS__MASK EQU 0x10
CapSense_Sns__LinearSlider0_e3__LS__PA__CFG0 EQU CYREG_UDB_PA1_CFG0
CapSense_Sns__LinearSlider0_e3__LS__PA__CFG1 EQU CYREG_UDB_PA1_CFG1
CapSense_Sns__LinearSlider0_e3__LS__PA__CFG10 EQU CYREG_UDB_PA1_CFG10
CapSense_Sns__LinearSlider0_e3__LS__PA__CFG11 EQU CYREG_UDB_PA1_CFG11
CapSense_Sns__LinearSlider0_e3__LS__PA__CFG12 EQU CYREG_UDB_PA1_CFG12
CapSense_Sns__LinearSlider0_e3__LS__PA__CFG13 EQU CYREG_UDB_PA1_CFG13
CapSense_Sns__LinearSlider0_e3__LS__PA__CFG14 EQU CYREG_UDB_PA1_CFG14
CapSense_Sns__LinearSlider0_e3__LS__PA__CFG2 EQU CYREG_UDB_PA1_CFG2
CapSense_Sns__LinearSlider0_e3__LS__PA__CFG3 EQU CYREG_UDB_PA1_CFG3
CapSense_Sns__LinearSlider0_e3__LS__PA__CFG4 EQU CYREG_UDB_PA1_CFG4
CapSense_Sns__LinearSlider0_e3__LS__PA__CFG5 EQU CYREG_UDB_PA1_CFG5
CapSense_Sns__LinearSlider0_e3__LS__PA__CFG6 EQU CYREG_UDB_PA1_CFG6
CapSense_Sns__LinearSlider0_e3__LS__PA__CFG7 EQU CYREG_UDB_PA1_CFG7
CapSense_Sns__LinearSlider0_e3__LS__PA__CFG8 EQU CYREG_UDB_PA1_CFG8
CapSense_Sns__LinearSlider0_e3__LS__PA__CFG9 EQU CYREG_UDB_PA1_CFG9
CapSense_Sns__LinearSlider0_e3__LS__PC EQU CYREG_PRT1_PC
CapSense_Sns__LinearSlider0_e3__LS__PC2 EQU CYREG_PRT1_PC2
CapSense_Sns__LinearSlider0_e3__LS__PORT EQU 1
CapSense_Sns__LinearSlider0_e3__LS__PS EQU CYREG_PRT1_PS
CapSense_Sns__LinearSlider0_e3__LS__SHIFT EQU 4
CapSense_Sns__LinearSlider0_e4__LS__DM__MASK EQU 0x38000
CapSense_Sns__LinearSlider0_e4__LS__DM__SHIFT EQU 15
CapSense_Sns__LinearSlider0_e4__LS__DR EQU CYREG_PRT1_DR
CapSense_Sns__LinearSlider0_e4__LS__INTCFG EQU CYREG_PRT1_INTCFG
CapSense_Sns__LinearSlider0_e4__LS__INTSTAT EQU CYREG_PRT1_INTSTAT
CapSense_Sns__LinearSlider0_e4__LS__MASK EQU 0x20
CapSense_Sns__LinearSlider0_e4__LS__PA__CFG0 EQU CYREG_UDB_PA1_CFG0
CapSense_Sns__LinearSlider0_e4__LS__PA__CFG1 EQU CYREG_UDB_PA1_CFG1
CapSense_Sns__LinearSlider0_e4__LS__PA__CFG10 EQU CYREG_UDB_PA1_CFG10
CapSense_Sns__LinearSlider0_e4__LS__PA__CFG11 EQU CYREG_UDB_PA1_CFG11
CapSense_Sns__LinearSlider0_e4__LS__PA__CFG12 EQU CYREG_UDB_PA1_CFG12
CapSense_Sns__LinearSlider0_e4__LS__PA__CFG13 EQU CYREG_UDB_PA1_CFG13
CapSense_Sns__LinearSlider0_e4__LS__PA__CFG14 EQU CYREG_UDB_PA1_CFG14
CapSense_Sns__LinearSlider0_e4__LS__PA__CFG2 EQU CYREG_UDB_PA1_CFG2
CapSense_Sns__LinearSlider0_e4__LS__PA__CFG3 EQU CYREG_UDB_PA1_CFG3
CapSense_Sns__LinearSlider0_e4__LS__PA__CFG4 EQU CYREG_UDB_PA1_CFG4
CapSense_Sns__LinearSlider0_e4__LS__PA__CFG5 EQU CYREG_UDB_PA1_CFG5
CapSense_Sns__LinearSlider0_e4__LS__PA__CFG6 EQU CYREG_UDB_PA1_CFG6
CapSense_Sns__LinearSlider0_e4__LS__PA__CFG7 EQU CYREG_UDB_PA1_CFG7
CapSense_Sns__LinearSlider0_e4__LS__PA__CFG8 EQU CYREG_UDB_PA1_CFG8
CapSense_Sns__LinearSlider0_e4__LS__PA__CFG9 EQU CYREG_UDB_PA1_CFG9
CapSense_Sns__LinearSlider0_e4__LS__PC EQU CYREG_PRT1_PC
CapSense_Sns__LinearSlider0_e4__LS__PC2 EQU CYREG_PRT1_PC2
CapSense_Sns__LinearSlider0_e4__LS__PORT EQU 1
CapSense_Sns__LinearSlider0_e4__LS__PS EQU CYREG_PRT1_PS
CapSense_Sns__LinearSlider0_e4__LS__SHIFT EQU 5
CapSense_Sns__PA__CFG0 EQU CYREG_UDB_PA1_CFG0
CapSense_Sns__PA__CFG1 EQU CYREG_UDB_PA1_CFG1
CapSense_Sns__PA__CFG10 EQU CYREG_UDB_PA1_CFG10
CapSense_Sns__PA__CFG11 EQU CYREG_UDB_PA1_CFG11
CapSense_Sns__PA__CFG12 EQU CYREG_UDB_PA1_CFG12
CapSense_Sns__PA__CFG13 EQU CYREG_UDB_PA1_CFG13
CapSense_Sns__PA__CFG14 EQU CYREG_UDB_PA1_CFG14
CapSense_Sns__PA__CFG2 EQU CYREG_UDB_PA1_CFG2
CapSense_Sns__PA__CFG3 EQU CYREG_UDB_PA1_CFG3
CapSense_Sns__PA__CFG4 EQU CYREG_UDB_PA1_CFG4
CapSense_Sns__PA__CFG5 EQU CYREG_UDB_PA1_CFG5
CapSense_Sns__PA__CFG6 EQU CYREG_UDB_PA1_CFG6
CapSense_Sns__PA__CFG7 EQU CYREG_UDB_PA1_CFG7
CapSense_Sns__PA__CFG8 EQU CYREG_UDB_PA1_CFG8
CapSense_Sns__PA__CFG9 EQU CYREG_UDB_PA1_CFG9
CapSense_Sns__PC EQU CYREG_PRT1_PC
CapSense_Sns__PC2 EQU CYREG_PRT1_PC2
CapSense_Sns__PORT EQU 1
CapSense_Sns__PS EQU CYREG_PRT1_PS

; Miscellaneous
CYDEV_BCLK__HFCLK__HZ EQU 24000000
CYDEV_BCLK__HFCLK__KHZ EQU 24000
CYDEV_BCLK__HFCLK__MHZ EQU 24
CYDEV_BCLK__SYSCLK__HZ EQU 24000000
CYDEV_BCLK__SYSCLK__KHZ EQU 24000
CYDEV_BCLK__SYSCLK__MHZ EQU 24
CYDEV_CHIP_DIE_GEN4 EQU 2
CYDEV_CHIP_DIE_LEOPARD EQU 1
CYDEV_CHIP_DIE_PANTHER EQU 12
CYDEV_CHIP_DIE_PSOC4A EQU 5
CYDEV_CHIP_DIE_PSOC5LP EQU 11
CYDEV_CHIP_DIE_UNKNOWN EQU 0
CYDEV_CHIP_FAMILY_PSOC3 EQU 1
CYDEV_CHIP_FAMILY_PSOC4 EQU 2
CYDEV_CHIP_FAMILY_PSOC5 EQU 3
CYDEV_CHIP_FAMILY_UNKNOWN EQU 0
CYDEV_CHIP_FAMILY_USED EQU CYDEV_CHIP_FAMILY_PSOC4
CYDEV_CHIP_JTAG_ID EQU 0x04C81193
CYDEV_CHIP_MEMBER_3A EQU 1
CYDEV_CHIP_MEMBER_4A EQU 5
CYDEV_CHIP_MEMBER_4C EQU 9
CYDEV_CHIP_MEMBER_4D EQU 3
CYDEV_CHIP_MEMBER_4E EQU 4
CYDEV_CHIP_MEMBER_4F EQU 6
CYDEV_CHIP_MEMBER_4G EQU 2
CYDEV_CHIP_MEMBER_4L EQU 8
CYDEV_CHIP_MEMBER_4M EQU 7
CYDEV_CHIP_MEMBER_5A EQU 11
CYDEV_CHIP_MEMBER_5B EQU 10
CYDEV_CHIP_MEMBER_UNKNOWN EQU 0
CYDEV_CHIP_MEMBER_USED EQU CYDEV_CHIP_MEMBER_4A
CYDEV_CHIP_DIE_EXPECT EQU CYDEV_CHIP_MEMBER_USED
CYDEV_CHIP_DIE_ACTUAL EQU CYDEV_CHIP_DIE_EXPECT
CYDEV_CHIP_REV_GEN4_ES EQU 17
CYDEV_CHIP_REV_GEN4_ES2 EQU 33
CYDEV_CHIP_REV_GEN4_PRODUCTION EQU 17
CYDEV_CHIP_REV_LEOPARD_ES1 EQU 0
CYDEV_CHIP_REV_LEOPARD_ES2 EQU 1
CYDEV_CHIP_REV_LEOPARD_ES3 EQU 3
CYDEV_CHIP_REV_LEOPARD_PRODUCTION EQU 3
CYDEV_CHIP_REV_PANTHER_ES0 EQU 0
CYDEV_CHIP_REV_PANTHER_ES1 EQU 1
CYDEV_CHIP_REV_PANTHER_PRODUCTION EQU 1
CYDEV_CHIP_REV_PSOC4A_ES0 EQU 17
CYDEV_CHIP_REV_PSOC4A_PRODUCTION EQU 17
CYDEV_CHIP_REV_PSOC5LP_ES0 EQU 0
CYDEV_CHIP_REV_PSOC5LP_PRODUCTION EQU 0
CYDEV_CHIP_REVISION_3A_ES1 EQU 0
CYDEV_CHIP_REVISION_3A_ES2 EQU 1
CYDEV_CHIP_REVISION_3A_ES3 EQU 3
CYDEV_CHIP_REVISION_3A_PRODUCTION EQU 3
CYDEV_CHIP_REVISION_4A_ES0 EQU 17
CYDEV_CHIP_REVISION_4A_PRODUCTION EQU 17
CYDEV_CHIP_REVISION_4C_PRODUCTION EQU 0
CYDEV_CHIP_REVISION_4D_PRODUCTION EQU 0
CYDEV_CHIP_REVISION_4E_PRODUCTION EQU 0
CYDEV_CHIP_REVISION_4F_PRODUCTION EQU 0
CYDEV_CHIP_REVISION_4F_PRODUCTION_256K EQU 0
CYDEV_CHIP_REVISION_4G_ES EQU 17
CYDEV_CHIP_REVISION_4G_ES2 EQU 33
CYDEV_CHIP_REVISION_4G_PRODUCTION EQU 17
CYDEV_CHIP_REVISION_4L_PRODUCTION EQU 0
CYDEV_CHIP_REVISION_4M_PRODUCTION EQU 0
CYDEV_CHIP_REVISION_5A_ES0 EQU 0
CYDEV_CHIP_REVISION_5A_ES1 EQU 1
CYDEV_CHIP_REVISION_5A_PRODUCTION EQU 1
CYDEV_CHIP_REVISION_5B_ES0 EQU 0
CYDEV_CHIP_REVISION_5B_PRODUCTION EQU 0
CYDEV_CHIP_REVISION_USED EQU CYDEV_CHIP_REVISION_4A_PRODUCTION
CYDEV_CHIP_REV_EXPECT EQU CYDEV_CHIP_REVISION_USED
CYDEV_CONFIG_READ_ACCELERATOR EQU 1
CYDEV_CONFIG_UNUSED_IO_AllowButWarn EQU 0
CYDEV_CONFIG_UNUSED_IO EQU CYDEV_CONFIG_UNUSED_IO_AllowButWarn
CYDEV_CONFIG_UNUSED_IO_AllowWithInfo EQU 1
CYDEV_CONFIG_UNUSED_IO_Disallowed EQU 2
CYDEV_CONFIGURATION_COMPRESSED EQU 1
CYDEV_CONFIGURATION_MODE_COMPRESSED EQU 0
CYDEV_CONFIGURATION_MODE EQU CYDEV_CONFIGURATION_MODE_COMPRESSED
CYDEV_CONFIGURATION_MODE_DMA EQU 2
CYDEV_CONFIGURATION_MODE_UNCOMPRESSED EQU 1
CYDEV_DEBUG_PROTECT_KILL EQU 4
CYDEV_DEBUG_PROTECT_OPEN EQU 1
CYDEV_DEBUG_PROTECT EQU CYDEV_DEBUG_PROTECT_OPEN
CYDEV_DEBUG_PROTECT_PROTECTED EQU 2
CYDEV_DEBUGGING_DPS_Disable EQU 3
CYDEV_DEBUGGING_DPS_SWD EQU 2
CYDEV_DEBUGGING_DPS EQU CYDEV_DEBUGGING_DPS_SWD
CYDEV_DEBUGGING_ENABLE EQU 1
CYDEV_DFT_SELECT_CLK0 EQU 1
CYDEV_DFT_SELECT_CLK1 EQU 2
CYDEV_HEAP_SIZE EQU 0x80
CYDEV_IMO_TRIMMED_BY_WCO EQU 0
CYDEV_PROJ_TYPE EQU 2
CYDEV_PROJ_TYPE_BOOTLOADER EQU 1
CYDEV_PROJ_TYPE_LAUNCHER EQU 5
CYDEV_PROJ_TYPE_LOADABLE EQU 2
CYDEV_PROJ_TYPE_LOADABLEANDBOOTLOADER EQU 4
CYDEV_PROJ_TYPE_MULTIAPPBOOTLOADER EQU 3
CYDEV_PROJ_TYPE_STANDARD EQU 0
CYDEV_STACK_SIZE EQU 0x0400
CYDEV_USE_BUNDLED_CMSIS EQU 1
CYDEV_VARIABLE_VDDA EQU 1
CYDEV_VDDA_MV EQU 3300
CYDEV_VDDD_MV EQU 3300
CYDEV_WDT_GENERATE_ISR EQU 1
CYIPBLOCK_M0S8_CTBM_VERSION EQU 0
CYIPBLOCK_m0s8cpuss_VERSION EQU 0
CYIPBLOCK_m0s8csd_VERSION EQU 0
CYIPBLOCK_m0s8gpio2_VERSION EQU 0
CYIPBLOCK_m0s8hsiom4a_VERSION EQU 0
CYIPBLOCK_m0s8lcd_VERSION EQU 0
CYIPBLOCK_m0s8lpcomp_VERSION EQU 0
CYIPBLOCK_m0s8pclk_VERSION EQU 0
CYIPBLOCK_m0s8sar_VERSION EQU 0
CYIPBLOCK_m0s8scb_VERSION EQU 0
CYIPBLOCK_m0s8srssv2_VERSION EQU 1
CYIPBLOCK_m0s8tcpwm_VERSION EQU 0
CYIPBLOCK_m0s8udbif_VERSION EQU 0
CYIPBLOCK_S8_GPIO_VERSION EQU 2
CYDEV_BOOTLOADER_ENABLE EQU 0
    ENDIF
    END
